// RF24 - Version: Latest 
#include <RF24.h>
#include <RF24_config.h>
#include <nRF24L01.h>
#include <printf.h>

/*

*/

#define RELAY_PORT 7
byte dataOpen[2] = {B00001, B11111111}; 
byte dataClose[2] = {B00001, B00000000}; 
byte addresses[][6] = {"1Node","2Node"};
RF24 radio(9,10);

void setup() {
  
  pinMode(RELAY_PORT, OUTPUT);
  radio.begin();

  // Set the PA Level low to prevent power supply related issues since this is a
 // getting_started sketch, and the likelihood of close proximity of the devices. RF24_PA_MAX is default.
  radio.setPALevel(RF24_PA_LOW);
  
  // Open a writing and reading pipe on each radio, with opposite addresses
  //if(radioNumber){
    radio.openWritingPipe(addresses[1]);
    radio.openReadingPipe(1,addresses[0]);
  //}else{
  //  radio.openWritingPipe(addresses[0]);
  //  radio.openReadingPipe(1,addresses[1]);
  //}
  
  // Start the radio listening for data
  radio.startListening();
}

void loop() {

    byte data[2]; 
    if( radio.available()){
                                                                    // Variable for the received timestamp
      while (radio.available()) {                                   // While there is data ready
        radio.read( &data, 5 );             // Get the payload
        //radio.read(&data,32);
        
        if(data[0] == dataOpen[0] && data[1] == dataOpen[1]){
          digitalWrite(RELAY_PORT, HIGH);
        }
        else if (data[0] == dataClose[0] && data[1] == dataClose[1]){
          digitalWrite(RELAY_PORT, LOW);
        }
      }
     
      //radio.stopListening();                                        // First, stop listening so we can talk   
      //radio.write( &got_time, sizeof(unsigned long) );              // Send the final one back.      
      //radio.startListening();                                       // Now, resume listening so we catch the next packets.     
      //Serial.print(F("Sent response "));
      //Serial.println(got_time);  
    }
  
  digitalWrite(RELAY_PORT, HIGH);  //Green LED on, Yellow LED off
   delay(1000);
   digitalWrite(RELAY_PORT, LOW);   //Yellow LED on, Green LED off
   delay(1000);

}
